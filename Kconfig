## libsel4/Kconfig
```kconfig
#
# Copyright 2017, Data61
# Commonwealth Scientific and Industrial Research Organisation (CSIRO)
# ABN 41 687 119 230.
#
# This software may be distributed and modified according to the terms of
# the BSD 2-Clause license. Note that NO WARRANTY is provided.
# See "LICENSE_BSD2.txt" for details.
#
# @TAG(DATA61_BSD)
#

menu "libsel4"
    config LIB_SEL4
        bool "libsel4"
        default y
        select HAVE_LIB_SEL4
        help
            seL4 API library

choice
    prompt "Function attributes"
    default LIB_SEL4_INLINE_INVOCATIONS

config LIB_SEL4_DEFAULT_FUNCTION_ATTRIBUTES
    bool "Default"
    depends on LIB_SEL4
    help
        Verification friendly default configuration. syscalls will be inlined,
        but generated functions will not.

config LIB_SEL4_INLINE_INVOCATIONS
    bool "Inline generated syscall invocations"
    depends on LIB_SEL4
    help
        When set to true will mark generated functions as 'inline', allowing
        them to be inlined by the callee user code. This may be undesirable
        for verification, so setting to 'n' will forcibly prevent the function
        from being inlined.

config LIB_SEL4_PUBLIC_SYMBOLS
    bool "Public symbols for all external interfaces"
    depends on LIB_SEL4
    help
        When set to true will make all user facing functions available as
        public symbols, which can be convenient for some language bindings.

endchoice

config LIB_SEL4_STUBS_USE_IPC_BUFFER_ONLY
    bool "use only IPC buffer for syscalls"
    depends on LIB_SEL4
    default n
    help
        When generating syscall wrappers, only use the IPC buffer for
        marshalling and unmarshalling arguments. Without this option set,
        arguments will be passed in registers where possible for better
        performance.

config HAVE_LIB_SEL4
    bool
endmenu
```

## src/arch/arm/Kconfig
```kconfig
#
# Copyright 2014, General Dynamics C4 Systems
#
# This software may be distributed and modified according to the terms of
# the GNU General Public License version 2. Note that NO WARRANTY is provided.
# See "LICENSE_GPLv2.txt" for details.
#
# @TAG(GD_GPL)
#

config HAVE_ARCH_TIMER
    bool
    default y
    depends on ARM_CORTEX_A15

config ENABLE_A9_PREFETCHER
    bool "Enable Cortex-A9 prefetcher"
    default n
    depends on ARM_CORTEX_A9
    help
        Cortex-A9 has an L1 and L2 prefetcher. By default
        they are disabled. This config options allows
        them to be turned on. Enabling the prefetchers
        requires that the kernel be in secure mode. ARM
        documents indicate that as of r4p1 version of
        Cortex-A9 the bits used to enable the prefetchers
        no longer exist, it is not clear if this is just
        a document error or not.

config EXPORT_PMU_USER
    bool "PL0 access to PMU"
    default n
    depends on (ARCH_ARM_V7A || ARCH_ARM_V8A) && !ARM_CORTEX_A8
    help
        Grant user access to Performance Monitoring Unit.
        WARNING: While useful for evaluating performance,
        this option opens timing and covert channels.

config EXPORT_PCNT_USER
    bool "PL0 access to generic timer CNTPCT and CNTFRQ"
    default y
    depends on HAVE_ARCH_TIMER
    help
        Grant user access to physical counter and counter
        frequency registers of the generic timer.
        WARNING: selecting this option opens a timing
        channel

config EXPORT_VCNT_USER
    bool "PL0 access to generic timer CNTVCT and CNTFRQ"
    default y
    depends on HAVE_ARCH_TIMER
    help
        Grant user access to virtual counter and counter
        frequency registers of the generic timer.
        WARNING: selecting this option opens a timing
        channel

choice
    prompt "IPC Buffer location"
    default IPC_BUF_TPIDRURW if !ARCH_ARM_V6
    default IPC_BUF_GLOBALS_FRAME if ARCH_ARM_V6
    depends on ARCH_AARCH32
    help
        Controls how the location of the IPC buffer is
        provided to the user

    config IPC_BUF_GLOBALS_FRAME
        bool "Globals frame"
        depends on ARCH_AARCH32 && (MAX_NUM_NODES = 1)
        help
            Put the address of the IPC buffer in a dedicated
            frame that is read only at user level. This works
            on all ARM platforms
    config IPC_BUF_TPIDRURW
        bool "ThreadID register"
        depends on !ARCH_ARM_V6
        help
            Put the address of the IPC buffer in the user
            readable/writeable ThreadID register. When enabled
            this has the result of the kernel overwriting
            any value the user writes to this register.
endchoice

config SMMU_INTERRUPT_ENABLE
    bool "Enable SMMU interrupts"
    default y if DEBUG_BUILD
    default n if !DEBUG_BUILD
    depends on ARM_SMMU
    help
        SMMU interrupts currently only serve a debug purpose as
        they are not forwarded to user level. Enabling this will
        cause some fault types to print out a message in the kernel.
        WARNING: Printing fault information is slow and rapid faults
        can result in all time spent in the kernel printing fault
        messages
```

## src/arch/riscv/Kconfig
```kconfig
#
# Copyright 2018, Data61
# Commonwealth Scientific and Industrial Research Organisation (CSIRO)
# ABN 41 687 119 230.
#
# This software may be distributed and modified according to the terms of
# the GNU General Public License version 2. Note that NO WARRANTY is provided.
# See "LICENSE_GPLv2.txt" for details.
#
# @TAG(DATA61_GPL)
#

#
#
# Copyright 2016, 2017 Hesham Almatary, Data61/CSIRO <hesham.almatary@data61.csiro.au>
# Copyright 2015, 2016 Hesham Almatary <heshamelmatary@gmail.com>
#

config HAVE_ARCH_TIMER
    bool
    default y

config PT_LEVELS
    int "Number of page table levels"
    default 3
    help
        Number of page tables levels for RISC-V depends on the mode. For
        example there are: 2, 3 and 4 levels on Sv32, Sv39, Sv48 RISC-V paging
        modes respectively.
```
