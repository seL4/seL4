/*
 * Copyright 2020, Data61, CSIRO (ABN 41 687 119 230)
 *
 * SPDX-License-Identifier: GPL-2.0-only
 */

/ {
	chosen {
		seL4,elfloader-devices =
		    &{/pl011@9000000},
		    &{/psci};
		seL4,kernel-devices =
            &{/pl011@9000000},
		    &{/intc@8000000},
		    &{/timer}; /* Watchdog timer */
	};

	memory@40000000 {
        reg = <0x0 0x60000000 0x0 0x60000000>;
	};

	vm-memory@40000000 {
		reg = <0x0 0x40000000 0x0 0x20000000>;
	};
};
