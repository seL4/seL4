/*
 * Copyright 2020, Data61, CSIRO (ABN 41 687 119 230)
 *
 * SPDX-License-Identifier: GPL-2.0-only
 */

/ {


	reserved-memory {
		#address-cells = < 0x02 >;
		#size-cells = < 0x02 >;
		ranges;

		vm-memory@40000000 {
			reg = <0x0 0x40000000 0x0 0x20000000>;
			no-map;
		};
	};


};
