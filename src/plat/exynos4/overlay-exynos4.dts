/*
 * Copyright 2020, Data61, CSIRO (ABN 41 687 119 230)
 *
 * SPDX-License-Identifier: GPL-2.0-only
 */

/ {
	chosen {
		seL4,elfloader-devices =
		    "serial1";

		seL4,kernel-devices =
		    "serial1",
		    &{/soc/interrupt-controller@10490000},
		    &{/soc/l2-cache-controller@10502000},
		    &{/soc/mct@10050000};
	};

	/delete-node/ memory;
	memory@40000000 {
		device_type = "memory";
	};

	/* HACK: 0xe0000000..0xff000000 is the largest contiguous region
	 * in the kernel window; we clamp to that and discard memory
	 * after the ASID PD hole (0xff200000..0xfff00000). This is a
	 * workaround for userspace tools (hardware_gen, elfloader, etc)
	 * which are not yet aware of the memory hole. */
	memory@40000000 {
		device_type = "memory";
		reg = < 0x40000000 0x1f000000 >;
	};
};
