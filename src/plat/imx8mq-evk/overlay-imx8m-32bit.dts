/*
 * Copyright 2019, Data61
 * Commonwealth Scientific and Industrial Research Organisation (CSIRO)
 * ABN 41 687 119 230.
 *
 * This software may be distributed and modified according to the terms of
 * the GNU General Public License version 2. Note that NO WARRANTY is provided.
 * See "LICENSE_GPLv2.txt" for details.
 *
 * @TAG(DATA61_GPL)
 */

/ {

    /* 32-bit kernel platforms require memory to be clamped to the top of
     * the kernel window.
     */
	memory@40000000 {
		device_type = "memory";
		reg = < 0x00 0x40000000 0x00 0x1f000000 >;
	};

	/* This device extends out of the 32-bit memory range.*/
	/delete-node/gpu@38000000;
};
