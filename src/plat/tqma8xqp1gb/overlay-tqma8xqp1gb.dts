/*
 * Copyright 2021, Breakaway Consulting Pty. Ltd.
 *
 * SPDX-License-Identifier: GPL-2.0-only
 */

/ {
	chosen {
		seL4,elfloader-devices =
			"serial1",
			&{/psci};

		seL4,kernel-devices =
			"serial1",
			&{/interrupt-controller@51a00000},
			&{/timer};
	};

	/*
	 * The GPT is not defined in the standard Linux device tree, so it is added explicitly
	 * here, based on chipset documentation.
	 */
    gpt@0x5d140000 {
        compatible = "fsl,imx8mq-gpt\0fsl,imx7d-gpt";
        reg = < 0x00 0x5d140000 0x00 0x10000 >;
        interrupts = < 0x00 0x50 0x04 >;
        status = "disabled";
    };
    reserved-memory {
        /* The following normal memory regions are Linux specific. */
        /delete-node/ dsp@92400000;
        /delete-node/ linux,cma;
    };
};
