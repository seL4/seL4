/*
 * Copyright 2018, Data61
 * Commonwealth Scientific and Industrial Research Organisation (CSIRO)
 * ABN 41 687 119 230.
 *
 * This software may be distributed and modified according to the terms of
 * the GNU General Public License version 2. Note that NO WARRANTY is provided.
 * See "LICENSE_GPLv2.txt" for details.
 *
 * @TAG(DATA61_GPL)
 */

/ {
	chosen {
		seL4,elfloader-devices =
			"serial0",
			&{/psci};

		seL4,kernel-devices =
			"serial0",
			&{/interrupt-controller@38800000},
			&{/timer};
	};

	/* This device exists in the SOC documentation, but not in the DTS from Linux */
	gpt@302e0000 {
		compatible = "fsl,imx8mq-gpt\0fsl,imx7d-gpt";
		reg = < 0x00 0x302e0000 0x00 0x10000 >;
		interrupts = < 0x00 0x36 0x04 >;
		clocks = < 0x04 0xc5 0x04 0xc5 0x04 0xf9 >;
		clock-names = "ipg\0per\0osc_per";
		status = "disabled";
	};

};
