/*
 * Copyright 2020, Data61, CSIRO (ABN 41 687 119 230)
 *
 * SPDX-License-Identifier: GPL-2.0-only
 */

/ {

    /* 32-bit kernel platforms require memory to be clamped to the top of
     * the kernel window.
     */
	memory@40000000 {
		device_type = "memory";
		reg = < 0x00 0x40000000 0x00 0x1f000000 >;
	};

	/* This device extends out of the 32-bit memory range.*/
	/delete-node/gpu@38000000;
};
