/*
 * Copyright 2020, Hensoldt Cyber
 *
 * SPDX-License-Identifier: BSD-3-Clause
 *
 */

/ {
    chosen {
        seL4,elfloader-devices =
            "serial0",
            &{/soc/aips-bus@2000000/src@20d8000};

        seL4,kernel-devices =
            "serial0",
            &{/soc/interrupt-controller@a01000},
            &{/soc/l2-cache@a02000},
            &{/soc/timer@a00600};
    };

    /* Upstream bug: the memory node doesn't have a device_type,
     * but there is an empty memory node with a device_type.
     */
    /delete-node/ memory;
    memory@80000000 {
        device_type = "memory";
        reg = <0x80000000 0x40000000>;
    };
};
