/*
 * Copyright 2023, UNSW
 * SPDX-License-Identifier: GPL-2.0-only
 */

/ {
    /delete-node/ memory;

    /* Memory for the 8GB RAM variant of the RPi4B, see overlay-pi4.dts for an
     * explanation of the memory ranges.
     */
    memory@0 {
        device_type = "memory";
        reg = < 0x00000000 0x00000000 0x3b400000
            0x00000000 0x40000000 0xbc000000
            0x00000001 0x00000000 0x80000000
            0x00000001 0x80000000 0x80000000 >;
    };
};
