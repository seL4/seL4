/*
 * Copyright 2020, Data61, CSIRO (ABN 41 687 119 230)
 *
 * SPDX-License-Identifier: GPL-2.0-only
 */

/ {
	/* Pick serial console */
	chosen {
		stdout-path = "serial2:115200n8";
		seL4,elfloader-devices =
		    "serial2";
		seL4,kernel-devices =
		    "serial2",
		    &{/soc/interrupt-controller@10481000},
		    &{/soc/mct@101c0000},
		    &{/soc/timer};
	};

	/* HACK: 0xe0000000..0xff000000 is the largest contiguous region
	 * in the kernel window; we clamp to that and discard memory
	 * after the ASID PD hole (0xff200000..0xfff00000). This is a
	 * workaround for userspace tools (hardware_gen, elfloader, etc)
	 * which are not yet aware of the memory hole. */
	memory@40000000 {
		reg = <0x60000000 0x1f000000>;
	};

	vm-memory@40000000 {
		reg = <0x40000000 0x20000000>;
	};

};
