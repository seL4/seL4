/*
 * Copyright 2019, DornerWorks
 *
 * This software may be distributed and modified according to the terms of
 * the GNU General Public License version 2. Note that NO WARRANTY is provided.
 * See "LICENSE_GPLv2.txt" for details.
 *
 * @TAG(DORNERWORKS_GPL)
 */

/ {
    amba {
    	/* bug: pcie node generates untyped objects too large for hypervisor mode */
    	/delete-node/ pcie@fd0e0000;
    };
};